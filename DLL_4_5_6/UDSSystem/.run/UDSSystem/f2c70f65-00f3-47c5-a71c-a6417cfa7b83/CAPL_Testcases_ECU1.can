/*@!Encoding:1252*/
includes
{
}

variables
{
enum bool {true=1, false=0};

  // Common Negative Response Codes (NRCs)
  const cNRC_GeneralReject=0x10;
  const cNRC_ServiceNotSupported=0x11;
  const cNRC_SubfunctionNotSupported=0x12;
  const cNRC_IncorrectMessageLengthOrInvalidFormat=0x13;
  const cNRC_BusyRepeatRequest=0x21;
  const cNRC_ConditionsNotCorrectOrRequestSequenceError=0x22;
  const cNRC_RequestSequenceError=0x24;
  const cNRC_RequestOutOfRange=0x31;
  const cNRC_SecurityAccessDenied=0x33;
  const cNRC_InvalidKey=0x35;
  const cNRC_RequestCorrectlyReceivedResponsePending=0x78;
  
  // Access modes for DiagGetParameter
  const cParamAccessNumerical = 0;
  const cParamAccessPhysical = 1;
  const cParamAccessCoded = 2;

  // Fault Memory types
  enum eFaultmemType {
    Undefined=0, KWP=2, UDS=3        // Enum contains size of DTC as value
  };
  
  // Send modes for UUDT
  enum eDIDSendMode {Slow=0x01, Medium=0x02, Fast=0x03, Off=0x04, Once=0xF2};
  
  // This timeout is used just to force CANoe to continue, i.e. normally a TestWaitForDiag...
  // function will return much earlier due to diagnostic level timing!
  const cApplicationTimeoutMs = 5000;
char gTestIdStr[10];     // Identifier generated for each test step shown in the test report
  word gTestCaseIndex=0;
  word gTestStepIndex=0;
diagRequest DoorFL.ExtendedDiagnosticSession_Start       sessionExtended;
  diagRequest DoorFL.ProgrammingSession_Start              sessionProgramming;
  diagRequest DoorFL.SeedLevel_0x11_Request                securitySeed;
  diagRequest DoorFL.KeyLevel_0x11_Send                    securityKey;
  diagRequest DoorFL.Download_Request                      downloadRequest;
  diagRequest DoorFL.Download_Transmit                     downloadTransmit;
  diagRequest DoorFL.Download_Stop                         downloadStop;

  byte  memorySpecification[8];
  long  maxBlockSize;
  dword transmittedSize;

  dword downloadSize;
  byte  downloadBuffer[64 * 1024];
  byte  downloadCounter;
  
  char moduleID[20]="TCDownload";
char gDiagTarget[7] = "DoorFL";         // ECU qualifier defined in the "Diagnostics/ISO TP..." configuration dialog
  char gResultString[200];                // String for temporary test step result outputs
  
  // Simulated Voltages applied via System Variable
  const cNormalVoltageValue_V=12.4;
  const cHighVoltageValue1_V=15.4;
  const cHighVoltageValue2_V=16.1;
  const cLowVoltageValue_V=9.5;
  
  const DTC_VoltageTooHigh=0x000002;
  
  char cExpectedSwitchedVariant[20]="CommonDiagnostics";
  char cExpectedIdentifiedVariant[20]="DevSample";
  
  enum eFaultmemType gFaultMemType=UDS;
}

ApplyVoltage(double voltage, dword ms)
{
  IncTestStepId();
  @sysvar::ExternalSignals::SupplyVoltage=voltage;
  TestStepPass (gTestIdStr, "Stimulate ECU with voltage %2.1fV for 1 sec.", voltage);
  testWaitForTimeout(ms); // Wait 1sec until DTC should have been stored in case of over- or undervoltage before reading the fault memory
}

InitFaultMemAndGenerateTwoDTCs()
{
  diagRequest DoorFL.FaultMemory_Clear reqClear;

  SendRequestAndWaitForResponse(reqClear, true); // Clear fault memory to have a defined precondition

  ApplyVoltage(cLowVoltageValue_V, 1010);   // Low voltage: Stimulate setting 1nd DTC (0x000001)
  ApplyVoltage(cHighVoltageValue1_V, 1010) ;// High voltage, 1st time: Stimulate setting 2st DTC (0x000002)
  ApplyVoltage(cNormalVoltageValue_V, 20);  // Set voltage back to normal level
  ApplyVoltage(cHighVoltageValue2_V, 1010); // High voltage, 2nd time:  Add snapshot record for DTC 0x000002
  ApplyVoltage(cNormalVoltageValue_V, 10);  // Set voltage back to normal level
}

export testcase TCDetermineVariant(int tcId)
{
  char activeVariant[50];
  char errStr[100];
  long ret;
  
  setTestId(tcId, 1);

  ret=diagGetActiveVariant(gDiagTarget,activeVariant, elcount(activeVariant));
  if (ret >= 0) {
    testStepPass(gTestIdStr, "Active variant BEFORE switching: %s", activeVariant);
  }
  else {
    testStepFail(gTestIdStr, "Error %d while getting active variant", ret);
  }

  IncTestStepId();
  ret=testWaitForDiagChangedActiveVariant(gDiagTarget, cExpectedSwitchedVariant);
  if(ret > 0 ) {
    testStepPass(gTestIdStr, "Successfully changed variant!");
  }
  else {
    diagGetErrorString(ret, errStr, elcount(errStr));
    testStepFail(gTestIdStr, "Error %d while changing active variant (%s)", ret, errStr);
  }

  IncTestStepId();
  ret=diagGetActiveVariant(gDiagTarget,activeVariant, elcount(activeVariant));
  if (ret >= 0) {
    if (strncmp(activeVariant, cExpectedSwitchedVariant, elcount(cExpectedSwitchedVariant))) {
      testStepFail(gTestIdStr, "Error: Active variant after switching (%s) different than expected (%s)!", activeVariant, cExpectedSwitchedVariant);
    }
    else {
      testStepPass(gTestIdStr, "Active variant AFTER first switching: %s", activeVariant);
    }
  }
  else {
    testStepFail(gTestIdStr, "Error %d while getting active variant", ret);
  }
  
  IncTestStepId();
  ret=testWaitForDiagSetIdentifiedVariant(gDiagTarget);
  if(ret > 0){
    testStepPass(gTestIdStr, "Successfully set identified variant!");
  }
  else {
    diagGetErrorString(ret, errStr, elcount(errStr));
    testStepFail(gTestIdStr, "Error %d while setting identified variant (%s)", ret, errStr);
  }
  
  IncTestStepId();
  ret=diagGetActiveVariant(gDiagTarget,activeVariant, elcount(activeVariant));
  if (ret >= 0) {
    if (strncmp(activeVariant, cExpectedIdentifiedVariant, elcount(cExpectedIdentifiedVariant))) {
      testStepFail(gTestIdStr, "Error: Identified variant (%s) different than expected (%s)!", activeVariant, cExpectedIdentifiedVariant);
    }
    else {
      testStepPass(gTestIdStr, "Active variant AFTER identification: %s", activeVariant);
    }
  }
  else {
    testStepFail(gTestIdStr, "Error %d while getting active variant", ret);
  }
}

export testcase TCSendDiagnosticRequest(int tcId)
{
  diagRequest DoorFL.SerialNumber_Read req; // Create a request object for the "Serial_Number_Read" service
  long ret;

  setTestId(tcId, 1);
  if (0<=(ret=diagSendRequest(req))) { // Trigger sending the request
    testStepPass(gTestIdStr, "Trigger sending the request succeded.");
  }
  else {    
    snprintf(gResultString, elcount(gResultString), "Trigger sending the request failed (Return code=%d)!", ret);
    testStepFail(gTestIdStr, gResultString);
  }
  // In this test case, there is no check whether the request really was sent on the network and no evaluation of the response is performed.
  // Therefore, wait until the response should be processed before continuing the test.
  testWaitForTimeout(300);
}

export testcase TCSetDoorContacts(int tcId)
{
  diagRequest DoorFL.Door_Status_Control reqCtrl;
  diagRequest DoorFL.Door_Status_ReturnControl reqRetCtrl;
  long ret;

  setTestId(tcId, 1);
  if (0<=(ret=diagSetParameter(reqCtrl, "Door_Contact/Door_Contact", 0))) { // Set status of all door contacts to "0"
    testStepPass(gTestIdStr, "Setting the parameter within the request before sending it succeded.");
  }
  else {
    snprintf(gResultString, elcount(gResultString), "Setting the parameter within the request failed (Return code=%d)!", ret);
    testStepFail(gTestIdStr, gResultString);
  }
  
  // The following library function sends the request and waits for the response.
  IncTestStepId();
  SendRequestAndWaitForResponse(reqCtrl, true);
  

  IncTestStepId();
  if (0<=(ret=diagSetParameter(reqCtrl, "Door_Contact.Door_contact_front_right", 1))) { // Set status of one single door contact to "1"
    testStepPass(gTestIdStr, "Setting the parameter within the request before sending it succeded.");
  }
  else {
    snprintf(gResultString, elcount(gResultString), "Setting the parameter within the request failed (Return code=%d)!", ret);
    testStepFail(gTestIdStr, gResultString);
  }
  
  IncTestStepId();
  // The following library function sends the request and waits for the response.
  SendRequestAndWaitForResponse(reqCtrl, true);
  
  IncTestStepId();
  SendRequestAndWaitForResponse(reqRetCtrl, true);
}

export testcase TCReadSerialNumber(int tcId)
{
  const cExpectedSerialNumber=1397051953;
  diagRequest DoorFL.SerialNumber_Read req; // Create a request object for the "Serial_Number_Read" service
  long ret;

  setTestId(tcId, 1);
  SendRequestAndWaitForResponse(req, true);

  IncTestStepId(); // Library function: Update test step ID for test report output
  if ( -1 == diagGetLastResponseCode() ){
    testStepPass(gTestIdStr, "The received response was a positive response.");
  }
  else {
    testStepFail(gTestIdStr, "The received response was a negative response.");
    return; // No parameter to evaluate in case of a negative response
  }
  
  IncTestStepId(); 
  if (cExpectedSerialNumber==(ret=diagGetRespParameter(req, "SerialNumber"))) { // Extract the serial number from the response and check it for correctness
    snprintf(gResultString, elcount(gResultString), "Read serial number is correct (%d).", ret);
    testStepPass(gTestIdStr, gResultString);
  }
  else {
    snprintf(gResultString, elcount(gResultString), "Read serial number is wrong (expected=%d, read=%d)!", cExpectedSerialNumber, ret);
    testStepFail(gTestIdStr, gResultString);
  }
}

export testcase TCReadFaultMemory(int tcId)
{
  char expectedSymbolicDTC_US[16] = "Voltage too low";
  char expectedSymbolicDTC_DE[20] = "Spannung zu niedrig";
  char expectedSymbolicDTC_JP[20] = "????";
  char receivedSymbolicDTC[20];
  diagRequest DoorFL.FaultMemory_ReadAllIdentified reqIdentified;
  long ret;
  word numberOfReadDTCs;

  setTestId(tcId, 1);
  InitFaultMemAndGenerateTwoDTCs();

  IncTestStepId(); 
  DiagSetParameter(reqIdentified, "DTCStatusMask.TestFailed", 1);  // DTCs with status "Test failed"
  SendRequestAndWaitForResponse(reqIdentified, true);

  IncTestStepId(); 
  ret=DiagGetRespPrimitiveSize(reqIdentified);
  numberOfReadDTCs=(ret-3)/(gFaultMemType+1); // length of response == header + DTCAvailabilityMask + numberOfReadDTCs * (size of DTC + status byte)
  if (2 == numberOfReadDTCs) { 
    snprintf(gResultString, elcount(gResultString), "Number of read DTCs is correct (%d).", numberOfReadDTCs);
    testStepPass(gTestIdStr, gResultString);
  }
  else {
    snprintf(gResultString, elcount(gResultString), "Number of read DTCs is wrong (expected=%d, read=%d)!", 2, numberOfReadDTCs);
    testStepFail(gTestIdStr, gResultString);
    return;
  }

  IncTestStepId(); 
  // Example: Symbolic access
  if (0>(ret=diagGetComplexRespParameter(reqIdentified, "ListOfDTC", 0, "DTC", receivedSymbolicDTC, elcount(receivedSymbolicDTC)))) { // Extract the DTC from the response and check it for correctness
    testStepFail(gTestIdStr, "Error when trying to read 1st DTC!");
  }
  else {  
    if (0!=strncmp(receivedSymbolicDTC, expectedSymbolicDTC_US, elcount(expectedSymbolicDTC_US)) &&
        0!=strncmp(receivedSymbolicDTC, expectedSymbolicDTC_DE, elcount(expectedSymbolicDTC_DE)) &&
        0!=strncmp(receivedSymbolicDTC, expectedSymbolicDTC_JP, elcount(expectedSymbolicDTC_JP))) {
      snprintf(gResultString, elcount(gResultString), "Read 1st DTC symbolic value is wrong (expected='%s', '%s' or '%s', read='%s')!", expectedSymbolicDTC_US, expectedSymbolicDTC_DE, expectedSymbolicDTC_JP, receivedSymbolicDTC);
      testStepFail(gTestIdStr, gResultString);
    }
    else {
      snprintf(gResultString, elcount(gResultString), "Read 1st DTC symbolic value is correct (%s).", receivedSymbolicDTC);
      testStepPass(gTestIdStr, gResultString);
    }
  }

  IncTestStepId(); 
  // Example: access by DTC
  if (0>(ret=diagGetComplexRespParameter(reqIdentified, "ListOfDTC", 1, "DTC"))) { // Extract the DTC from the response and check it for correctness
    testStepFail(gTestIdStr, "Error when trying to read 2nd DTC!");
  }
  else {  
    if (DTC_VoltageTooHigh!=ret) { 
      snprintf(gResultString, elcount(gResultString), "Read 2nd DTC is wrong (expected=0x%06x, read=0x%06x)!", DTC_VoltageTooHigh, ret);
      testStepFail(gTestIdStr, gResultString);
    }
    else {
      snprintf(gResultString, elcount(gResultString), "Read 2nd DTC is correct (0x%06x).", ret);
      testStepPass(gTestIdStr, gResultString);
    }
  }
}

export testcase TCReadExtendedData(int tcId)
{
  diagRequest DoorFL.FaultMemory_Clear reqClear;
  diagRequest DoorFL.FaultMemory_Read_extended_data_record reqExtended;
  long ret;
  double receivedVoltageValue;
  
  setTestId(tcId, 1);
  InitFaultMemAndGenerateTwoDTCs();
  
  IncTestStepId(); 
  if (0<=(ret=diagSetParameter(reqExtended, "DTC", DTC_VoltageTooHigh))) {
    testStepPass(gTestIdStr, "Setting parameter 'DTC' within the request before sending it succeded.");
  }
  else {
    snprintf(gResultString, elcount(gResultString), "Setting the parameter 'DTC' within the request failed (Return code=%d)!", ret);
    testStepFail(gTestIdStr, gResultString);
  }

  IncTestStepId(); 
  if (0<=(ret=diagSetParameter(reqExtended, "DTCExtendedDataRecordNumber_CommonDiagnostics_Data_Object_Defaul", 1))) {
    testStepPass(gTestIdStr, "Setting parameter 'DTCExtendedDataRecordNumber' within the request before sending it succeded.");
  }
  else {
    snprintf(gResultString, elcount(gResultString), "Setting the parameter 'DTCExtendedDataRecordNumber' within the request failed (Return code=%d)!", ret);
    testStepFail(gTestIdStr, gResultString);
  }
  
  IncTestStepId(); 
  SendRequestAndWaitForResponse(reqExtended, true);
  
  IncTestStepId(); 
  if (DTC_VoltageTooHigh==(ret=diagGetRespParameter(reqExtended, "DTC"))) {
    testStepPass(gTestIdStr, "Received DTC for Extended Data as expected.");
  }
  else {
    snprintf(gResultString, elcount(gResultString), "Received DTC for Extended Data was wrong (expected=%d, received=%d)!", DTC_VoltageTooHigh, ret);
    testStepFail(gTestIdStr, gResultString);
  }

  IncTestStepId(); 
  if (1==(ret=diagGetComplexRespParameter(reqExtended, "ListOfDTCExtendedDataRecord", 0, "DTCExtendedDataRecordNumber_Data_Object_PR"))) {
    testStepPass(gTestIdStr, "Received ExtendedDataRecordNumber as expected.");
  }
  else {
    snprintf(gResultString, elcount(gResultString), "Received ExtendedDataRecordNumber was wrong (expected=%d, received=%d)!", 1, ret);
    testStepFail(gTestIdStr, gResultString);
  }
  
  IncTestStepId(); 
  if (cHighVoltageValue1_V==(receivedVoltageValue=diagGetComplexRespParameter(reqExtended, cParamAccessPhysical, "ListOfDTCExtendedDataRecord", 0, "ExtDataVoltage"))) {
    testStepPass(gTestIdStr, "Received Extended Data with Voltage value as expected.");
  }
  else {
    snprintf(gResultString, elcount(gResultString), "Received Voltage in Extended Data was wrong (expected=%2.1fV, received=%2.1fV)!", cHighVoltageValue1_V, receivedVoltageValue);
    testStepFail(gTestIdStr, gResultString);
  }
}

export testcase TCReadSnapshotData(int tcId)
{
  diagRequest DoorFL.FaultMemory_Clear reqClear;
  diagRequest DoorFL.FaultMemory_Read_snapshot_by_DTC reqSnapshot;
  long ret;

  setTestId(tcId, 1);
  InitFaultMemAndGenerateTwoDTCs();
  
  IncTestStepId(); 
  if (0<=(ret=diagSetParameter(reqSnapshot, "DTC", DTC_VoltageTooHigh))) {
    testStepPass(gTestIdStr, "Setting parameter 'DTC' within the request before sending it succeded.");
  }
  else {
    snprintf(gResultString, elcount(gResultString), "Setting the parameter 'DTC' within the request failed (Return code=%d)!", ret);
    testStepFail(gTestIdStr, gResultString);
  }

  IncTestStepId(); 
  if (0<=(ret=diagSetParameter(reqSnapshot, "DTCSnapshotRecordNumber_CommonDiagnostics_Data_Object", 2))) {
    testStepPass(gTestIdStr, "Setting parameter 'DtcSnapshotRecordNumber_CommonDiagnostics_Data_Object' for 2nd snapshot record succeded.");
  }
  else {
    snprintf(gResultString, elcount(gResultString), "Setting the parameter 'DtcSnapshotRecordNumber_CommonDiagnostics_Data_Object' within the request failed (Return code=%d)!", ret);
    testStepFail(gTestIdStr, gResultString);
  }
  
  IncTestStepId(); 
  SendRequestAndWaitForResponse(reqSnapshot, true);  
}

export testcase TCWriteAndReadMuxData(int tcId)
{
  diagRequest DoorFL.DID_MuxedTestData_Write reqWrite;
  diagRequest DoorFL.DID_MuxedTestData_Read reqRead;
  byte MuxContents[15]={0x01, 0x02, 0x03, 0x04, 0x05, 0x06, 0x07, 0x08, 0x09, 0x0A, 0x0B, 0x0C, 0x0D, 0x0E, 0x0F};
  long ret;
  
  setTestId(tcId, 1);
  if (0<=(ret=diagSetParameter(reqWrite, "Selector", "Mux_Linear"))) {
    testStepPass(gTestIdStr, "Setting parameter 'Selector' within the write request before sending it succeded.");
  }
  else {
    snprintf(gResultString, elcount(gResultString), "Setting the parameter 'Selector' within the read request failed (Return code=%d)!", ret);
    testStepFail(gTestIdStr, gResultString);
  }

  diagResize(reqWrite, 8);
  testReportWriteDiagObject(reqWrite);
  
  IncTestStepId(); 
  if (0<=(ret=diagSetParameterRaw(reqWrite, "Linear", MuxContents, 4))) {  // only 4 bytes ("Linear" datatype)
    testStepPass(gTestIdStr, "Setting parameter 'Linear' within the request before sending it succeded.");
  }
  else {
    snprintf(gResultString, elcount(gResultString), "Setting the parameter 'Linear' within the request failed (Return code=%d)!", ret);
    testStepFail(gTestIdStr, gResultString);
  }

  IncTestStepId(); 
  SendRequestAndWaitForResponse(reqWrite, true);
  
  testReportWriteDiagObject(reqRead);

  IncTestStepId(); 
  SendRequestAndWaitForResponse(reqRead, true);
  
  IncTestStepId(); 
  if (0<=(ret=diagGetRespParameterRaw(reqRead, "Linear", MuxContents, 4))) {  // only 4 bytes ("Linear" datatype)
    testStepPass(gTestIdStr, "Getting parameter 'Linear' within the read response succeded.");
  }
  else {
    snprintf(gResultString, elcount(gResultString), "Getting the parameter 'Linear' within the read response failed (Return code=%d)!", ret);
    testStepFail(gTestIdStr, gResultString);
  }


}

UpdateTestIdStr()
{
  snprintf(gTestIdStr, elcount(gTestIdStr), "%d.%d", gTestCaseIndex, gTestStepIndex);
}

InitLibraryFunctions()
{
  // Init Testcase ID String
  setTestId(1, 1);
}

setTestId(word tcIndex, word tsIndex)
{
  gTestCaseIndex=tcIndex;
  gTestStepIndex=tsIndex;
  updateTestIdStr();
}

IncTestStepId()
{
  gTestStepIndex++;
  UpdateTestIdStr();
}

word SendRequestAndWaitForResponse(diagRequest *req, enum bool posResponseExpected)
{
  long ret;

  // Trigger sending the request
  if (0 > (ret=req.SendRequest())) { 
    snprintf(gResultString, elcount(gResultString), "Trigger sending the request failed (Return code=%d)!", ret);
    testStepFail(gTestIdStr, gResultString);
    return 0;
  }
  testStepPass(gTestIdStr, "Trigger sending the request succeded.");

  incTestStepId();
  // Wait until the complete request has been sent, e.g. in case of long requests which spread over several messages (segmented message)
  if (1!=(ret=testWaitForDiagRequestSent(req, cApplicationTimeoutMs))){ 
    snprintf(gResultString, elcount(gResultString), "Failed to finish sending the request (Return code=%d)!", ret);
    testStepFail(gTestIdStr, gResultString);
    return 0;
  }
  testStepPass(gTestIdStr, "Request was sent successfully.");

  incTestStepId();
  // Wait until the complete response has been received, e.g. segmented messages might take some time for transmission
  if (1!=(ret=testWaitForDiagResponse(req, cApplicationTimeoutMs))) {          
    snprintf(gResultString, elcount(gResultString), "Valid response missing or received too late (Return code=%d)!", ret);
    testStepFail(gTestIdStr, gResultString);
    return 0;
  }
  testStepPass(gTestIdStr, "Response received successfully.");

  incTestStepId();
  // Check whether the response was a positive response
  if (-1==(ret=diagGetLastResponseCode(req))) {
    if (!posResponseExpected) {
      snprintf(gResultString, elcount(gResultString), "Positive response received although negative response was expected!");
      testStepFail(gTestIdStr, gResultString);
      return 0;
    }
    testStepPass(gTestIdStr, "Positive Response received as expected.");
  }
  else if (ret>0) {
    if (posResponseExpected) {
      snprintf(gResultString, elcount(gResultString), "Negative response received (NRC=0x%02x) although positive response was expected!", ret);
      testStepFail(gTestIdStr, gResultString);
      return 0;
    }
    testStepPass(gTestIdStr, "Negative Response received as expected (NRC=%d).", ret);
  }
  return 1;
}

tsFailWithRetCode(char error_text[], long ret)
{
  snprintf(gResultString, elcount(gResultString), "%s failed (Return code=%ld)!", error_text, ret);
  testStepFail(gTestIdStr, gResultString);
}

export testcase TCDownload(int tcId)
{
  long ret;
  byte seedArray[4]; 
  byte keyArray[4];
  dword keyActualSize;
  dword i;
  
  byte  lengthFormatIdentifier;
  dword blockSpecSize;
  byte  blockSpec[4];
  

  //---------------------------------------------------------------------------------
  // Fill buffer to be downloaded to simulated ECU with data unequal zero
  //---------------------------------------------------------------------------------
  downloadSize=@sysvar::Tester_Display::DownloadSize;
  for (i=0;i<downloadSize; i++) {
    downloadBuffer[i]=i%256;
  }

  SetTestId(tcId,1);
  //---------------------------------------------------------------------------------
  TestStep( "", "Stop Tester Present to reduce unnecessary bus traffic...");
  //---------------------------------------------------------------------------------

  ret=DiagStopTesterPresent(gDiagTarget);
  if (0 !=ret) {
    tsFailWithRetCode("DiagStopTesterPresent()", ret);
  }
  TestStepPass( gTestIdStr, "Tester Present stopped.");


  IncTestStepId();
  //---------------------------------------------------------------------------------
  TestStep( "", "Switch to extended session...");
  //---------------------------------------------------------------------------------

  if (!SendRequestAndWaitForResponse(sessionExtended, true)) return;
  TestStepPass( "", "Extended session started.");

  
  IncTestStepId();
  //---------------------------------------------------------------------------------
  TestStep( "", "Switch to programming session...");
  //---------------------------------------------------------------------------------

  if (!SendRequestAndWaitForResponse(sessionProgramming, true)) return;
  TestStepPass( "", "Programming session started.");


  IncTestStepId();
  //---------------------------------------------------------------------------------
  TestStep( "", "Request security seed...");
  //---------------------------------------------------------------------------------
  if (!SendRequestAndWaitForResponse(securitySeed, true)) return;
  if ( (ret=diagGetRespParameterRaw(securitySeed, "SecuritySeed", seedArray, elCount(seedArray)))<0) {
    tsFailWithRetCode("diagGetRespParameterRaw()", ret); 
    return;
  }
  else {
    if ( (ret=diagGenerateKeyFromSeed(gDiagTarget, seedArray, elcount(seedArray), 1, "", "", keyArray, elcount(keyArray), keyActualSize)) !=0) {
      tsFailWithRetCode("diagGenerateKeyFromSeed()", ret);
      return;
    };
  }
  TestStepPass( "", "Got security seed and generated key.");
  

  IncTestStepId();
  //---------------------------------------------------------------------------------
  TestStep( "", "Write security key...");
  //---------------------------------------------------------------------------------
  DiagSetParameterRaw( securityKey, "SecurityKey", keyArray, elcount(keyArray));
  if (!SendRequestAndWaitForResponse(securityKey, true)) return;
  TestStepPass( "", "Security key written");


  IncTestStepId();
  //---------------------------------------------------------------------------------
  TestStep( "", "Request download session...");
  //---------------------------------------------------------------------------------
  maxBlockSize = 0;
  memorySpecification[7] = ( byte)( ( downloadSize & 0x000000FF) >>  0);
  memorySpecification[6] = ( byte)( ( downloadSize & 0x0000FF00) >>  8);
  memorySpecification[5] = ( byte)( ( downloadSize & 0x00FF0000) >> 16);
  memorySpecification[4] = ( byte)( ( downloadSize & 0xFF000000) >> 24);
  DiagSetParameter( downloadRequest, "DFI_", 0); // dataFormatIdentifier
  DiagSetParameter( downloadRequest, "ALFID", 0x44); // addressAndLengthFormatIdentifier: 4 Byte memorySize, 4 Byte memoryAddress
  DiagSetParameterRaw( downloadRequest, "MA_MS_", memorySpecification, elCount(memorySpecification));
  if (!SendRequestAndWaitForResponse(downloadRequest, true)) return;

  lengthFormatIdentifier = DiagGetRespParameter( downloadRequest, "LFID"); // lengthFormatIdentifier
  blockSpecSize = ( lengthFormatIdentifier & 0xF0) >> 4;
  if ( blockSpecSize > 4)
  {
    writeLineEx( -3, 3, "%s: ***** Unexpected blockSpecSize (%d)", moduleID, blockSpecSize);
    testStepFail(gTestIdStr, "Unexpected blockSpecSize (%d)!", blockSpecSize);
    return;
  }
  
  for (i=0; i<blockSpecSize; i++) { //MaxNumberOfBlockLength
    if ((ret=DiagGetRespPrimitiveByte(downloadRequest, i+2))<0) {
      tsFailWithRetCode("DiagGetRespPrimitiveByte()", ret);
      return;
    }
    else {
      blockSpec[i]=(byte)ret;
    }
  }
  
  maxBlockSize = 0;
  for ( i = 0; i < blockSpecSize; ++i)
  {
    maxBlockSize <<= 8;
    maxBlockSize += blockSpec[i];
  }

  maxBlockSize -= 2;
  if ( maxBlockSize < 0)                                                          {
    snprintf(gResultString, elcount(gResultString), "Unexpected maxBlockSize(=%d)!", maxBlockSize);
    testStepFail(gTestIdStr, gResultString);
    return;
  }
  TestStepPass( "", "Download session activated.");

  writeLineEx( 0, 1, "%s: Using block size %d bytes", moduleID, maxBlockSize);


  //---------------------------------------------------------------------------------
  TestStep( "", "Download data...");
  //---------------------------------------------------------------------------------
  transmittedSize = 0;
  downloadCounter = 0;
  while ( transmittedSize < downloadSize)
  {
    if ( downloadSize - transmittedSize < maxBlockSize)
    {
      maxBlockSize = downloadSize - transmittedSize;
    }
    downloadCounter++;
    DiagSetParameter( downloadTransmit, "blockSequenceCounter", downloadCounter);
    DiagSetParameterRaw( downloadTransmit, "transferRequestParameterRecord", downloadBuffer, maxBlockSize);

    IncTestStepId();
    if (!SendRequestAndWaitForResponse(downloadTransmit, true)) return;
    transmittedSize += maxBlockSize;
  }
  TestStepPass( "", "Download data completed.");

  
  IncTestStepId();
  //---------------------------------------------------------------------------------
  TestStep( "", "Request download stop...");
  //---------------------------------------------------------------------------------
  if (!SendRequestAndWaitForResponse(downloadStop, true)) return;
  TestStepPass( "", "Download stopped.");
  writeLineEx( 0, 1, "%s: Flashed %d bytes", moduleID, downloadSize);


  IncTestStepId();
  //---------------------------------------------------------------------------------
  TestStep( "", "Start Tester Present...");
  //---------------------------------------------------------------------------------
  ret=DiagStartTesterPresent(gDiagTarget);
  if (0 !=ret) {
    tsFailWithRetCode("DiagStartTesterPresent", ret);
  }
  TestStepPass( gTestIdStr, "Tester Present started.");
}
